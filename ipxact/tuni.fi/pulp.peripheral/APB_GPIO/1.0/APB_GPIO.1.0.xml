# APB_GPIO: IP-XACT component
VLNV tuni.fi:pulp.peripheral:APB_GPIO:1.0

## Parameters
APB_ADDR_WIDTH = 12 — APB slaves are 4KB by default
PAD_NUM = 32
NBIT_PADCFG = 4

## Bus interfaces (logical=physical port)
APB: target tuni.fi:interface:APB:1.0, memory map apb_gpio
  PADDR=PADDR, PENABLE=PENABLE, PRDATA=PRDATA, PREADY=PREADY, PSEL=PSEL, PSLVERR=PSLVERR, PWDATA=PWDATA, PWRITE=PWRITE
Clock: target tuni.fi:interface:clock:1.0
  clk=HCLK
Reset_n: target tuni.fi:interface:reset:1.0
  reset=HRESETn
GPIO: initiator tuni.fi:interface:GPIO:1.0
  gpo=gpio_out, gpi=gpio_in, gpio_oe=gpio_dir
IRQ: initiator tuni.fi:interface:IRQ:1.0
  irq=interrupt

## Ports
in PADDR[APB_ADDR_WIDTH-1:0]
in PENABLE
out PRDATA[31:0]
out PREADY
in PSEL
out PSLVERR
in PWDATA[31:0]
in PWRITE
in HCLK
in HRESETn
out gpio_out[PAD_NUM-1:0]
in gpio_in[PAD_NUM-1:0]
out interrupt
out gpio_dir[PAD_NUM-1:0]
out gpio_padcfg[NBIT_PADCFG-1:0]
in dft_cg_enable_i
out gpio_in_sync[PAD_NUM-1:0]

## Address spaces and blocks
apb_gpio.addressBlock: base 'h0, range 112, width 32

## Registers
Registers are 32-bit, access not given, no defined reset value unless marked. A register's access mark holds for its fields unless they carry their own. Offsets are from the block's base; lines under a group give offsets from that group; [hi:lo] are bit positions; {n}, {i} and the like mark numbered series; 'fields as' and 'values as' point back to an identical list; <NAME> marks a mode.

## apb_gpio.addressBlock
Base 0x00000000
0x00 REG_PADDIR_00_31 — Pad Direction. Control the direction of each of the GPIO pads. A value of 1 means it is configured as an output, while 0 configures it as an input.
0x04 REG_GPIOEN_00_31 — Input Values.
0x08 REG_PADIN_00_31 — Output Values.
0x0C REG_PADOUT_00_31 — Interrupt Enable. Interrupt enable per input bit. INTTYPE0 and INTTYPE1 control the interrupt triggering behavior.
0x10 REG_PADOUTSET_00_31 — Interrupt Type 0. Controls the interrupt trigger behavior together with INTTYPE1. Use INTEN to enable interrupts first.
0x14 REG_PADOUTCLR_00_31 — Interrupt Type 1. Controls the interrupt trigger behavior together with INTTYPE0. Use INTEN to enable interrupts first.
0x18 REG_INTEN_00_31 — Interrupt Status. Contains interrupt status per GPIO line. The status register is cleared when read. Similarly the interrupt line is high while a bit is set in interrupt status and will be deasserted when the status register is read.
0x1C REG_INTTYPE_00_15
0x20 REG_INTTYPE_16_31 — Pad Configuration Registers. The pad configuration registers control various aspects of the pads that are typically used in ASICs, e.g. drive strength, Schmitt-Triggers, Slew Rate, etc. Since those configuration parameters depend on the exact pads used, each implementation is free to use the PADCFG0-7 registers in every way it wants and also leave them unconnected, if unneeded.
  [31:0] REG_INTTYPE_16_31_0
0x24 REG_INTSTATUS_00_31 — Pad Configuration Registers. The pad configuration registers control various aspects of the pads that are typically used in ASICs, e.g. drive strength, Schmitt-Triggers, Slew Rate, etc. Since those configuration parameters depend on the exact pads used, each implementation is free to use the PADCFG0-7 registers in every way it wants and also leave them unconnected, if unneeded.
0x28 REG_PADCFG_00_07 — Pad Configuration Registers. The pad configuration registers control various aspects of the pads that are typically used in ASICs, e.g. drive strength, Schmitt-Triggers, Slew Rate, etc. Since those configuration parameters depend on the exact pads used, each implementation is free to use the PADCFG0-7 registers in every way it wants and also leave them unconnected, if unneeded.
0x2C REG_PADCFG_08_15 — Pad Configuration Registers. The pad configuration registers control various aspects of the pads that are typically used in ASICs, e.g. drive strength, Schmitt-Triggers, Slew Rate, etc. Since those configuration parameters depend on the exact pads used, each implementation is free to use the PADCFG0-7 registers in every way it wants and also leave them unconnected, if unneeded.
0x30 REG_PADCFG_16_23 — Pad Configuration Registers. The pad configuration registers control various aspects of the pads that are typically used in ASICs, e.g. drive strength, Schmitt-Triggers, Slew Rate, etc. Since those configuration parameters depend on the exact pads used, each implementation is free to use the PADCFG0-7 registers in every way it wants and also leave them unconnected, if unneeded.
0x34 REG_PADCFG_24_31 — Pad Configuration Registers. The pad configuration registers control various aspects of the pads that are typically used in ASICs, e.g. drive strength, Schmitt-Triggers, Slew Rate, etc. Since those configuration parameters depend on the exact pads used, each implementation is free to use the PADCFG0-7 registers in every way it wants and also leave them unconnected, if unneeded.
0x38 REG_PADDIR_32_63 — Pad Configuration Registers. The pad configuration registers control various aspects of the pads that are typically used in ASICs, e.g. drive strength, Schmitt-Triggers, Slew Rate, etc. Since those configuration parameters depend on the exact pads used, each implementation is free to use the PADCFG0-7 registers in every way it wants and also leave them unconnected, if unneeded.
0x3C REG_GPIOEN_32_63 — Pad Configuration Registers. The pad configuration registers control various aspects of the pads that are typically used in ASICs, e.g. drive strength, Schmitt-Triggers, Slew Rate, etc. Since those configuration parameters depend on the exact pads used, each implementation is free to use the PADCFG0-7 registers in every way it wants and also leave them unconnected, if unneeded.
0x40 REG_PADIN_32_63
0x44 REG_PADOUT_32_63
0x48 REG_PADOUTSET_32_63
0x4C REG_PADOUTCLR_32_63
0x50 REG_INTEN_32_63
0x54 REG_INTTYPE_32_47
0x58 REG_INTTYPE_48_63
0x5C REG_INTSTATUS_32_63
0x60 REG_PADCFG_32_39
0x64 REG_PADCFG_40_47
0x68 REG_PADCFG_48_55
0x6C REG_PADCFG_56_63
