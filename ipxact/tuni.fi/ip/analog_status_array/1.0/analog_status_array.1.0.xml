# analog_status_array: IP-XACT component
VLNV tuni.fi:ip:analog_status_array:1.0

## Bus interfaces (logical=physical port)
reset: target tuni.fi:interface:reset:1.0
  reset=reset_n
clk: target tuni.fi:interface:clock:1.0
  clk=clk_in
status_1: target tuni.fi:interface:GPIO:1.0
  gpo=status_1
APB: target tuni.fi:interface:APB:1.0, memory map AnalogStatusMap
  PADDR=PADDR, PENABLE=PENABLE, PRDATA=PRDATA, PREADY=PREADY, PSEL=PSEL, PSLVERR=PSLVERR, PWDATA=PWDATA, PWRITE=PWRITE, PSTRB=PSTRB
status_0: target tuni.fi:interface:GPIO:1.0
  gpo=status_0
status_2: target tuni.fi:interface:GPIO:1.0
  gpo=status_2
status_3: target tuni.fi:interface:GPIO:1.0
  gpo=status_3

## Ports
in reset_n
in clk_in
in status_{n}[31:0] (n=0..3)
in PADDR[11:0]
in PENABLE
out PRDATA[31:0]
out PREADY
in PSEL
out PSLVERR
in PWDATA[31:0]
in PWRITE
in PSTRB[3:0]

## Address spaces and blocks
AnalogStatusMap.RegBlock: base 'h0, range 'h16, width 32

## Registers
Registers are 32-bit, read-only, no defined reset value unless marked. A register's access mark holds for its fields unless they carry their own. Offsets are from the block's base; lines under a group give offsets from that group; [hi:lo] are bit positions; {n}, {i} and the like mark numbered series; 'fields as' and 'values as' point back to an identical list; <NAME> marks a mode.

## AnalogStatusMap.RegBlock
Base 0x00000000
0x00 status_0
0x04 status_1
0x08 status_2
  [31:0] status_3
0x12 status_3
  [31:0] status_4
