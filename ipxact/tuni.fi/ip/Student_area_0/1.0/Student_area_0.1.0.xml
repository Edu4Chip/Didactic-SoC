# Student_area_0: IP-XACT component
VLNV tuni.fi:subsystem:Student_area_0:1.0
very basic example of logic for plausible student block.

## Parameters
APB_AW = 12
APB_DW = 32

## Bus interfaces (logical=physical port)
APB: target tuni.fi:interface:APB:1.0, memory map memoryMap
  PADDR=PADDR, PENABLE=PENABLE, PRDATA=PRDATA, PREADY=PREADY, PSEL=PSEL, PSLVERR=PSLVERR, PWDATA=PWDATA, PWRITE=PWRITE, PSTRB=PSTRB
IRQ: initiator tuni.fi:interface:IRQ:1.0
  irq=irq
SS_Ctrl: target tuni.fi:interface:SS_Ctrl:1.0
  clk_ctrl=clk_ctrl, irq_en=irq_en
clk: target tuni.fi:interface:clock:1.0
  clk=clk_in
reset: target tuni.fi:interface:reset:1.0
  reset=rst
pmod_gpio: initiator tuni.fi:interface:GPIO:1.0
  gpo=pmod_gpo, gpi=pmod_gpi, gpio_oe=pmod_gpio_oe
high_speed_clk: target tuni.fi:interface:clock:1.0
  clk=high_speed_clk

## Ports
in PADDR[APB_AW-1:0]
in PENABLE
out PRDATA[APB_DW-1:0]
out PREADY
in PSEL
in PWDATA[APB_DW-1:0]
in PWRITE
out irq
in clk_ctrl[7:0]
in irq_en
in clk_in
in rst
out PSLVERR
in high_speed_clk
in PSTRB[APB_DW/8-1:0]
in pmod_gpi[15:0]
out pmod_gpo[15:0]
out pmod_gpio_oe[15:0]

## Address spaces and blocks
memoryMap.addressBlock: base 'h0, range 8, width 32

## Registers
Registers are 32-bit, read-write, no defined reset value unless marked. A register's access mark holds for its fields unless they carry their own. Offsets are from the block's base; lines under a group give offsets from that group; [hi:lo] are bit positions; {n}, {i} and the like mark numbered series; 'fields as' and 'values as' point back to an identical list; <NAME> marks a mode.

## memoryMap.addressBlock
Base 0x00000000
0x00 regfield0
  [31:0] field
