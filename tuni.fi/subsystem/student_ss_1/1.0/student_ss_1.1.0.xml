# student_ss_1: IP-XACT component
VLNV tuni.fi:subsystem:student_ss_1:1.0

## Parameters
APB_DW = 32
APB_AW = 10

## Bus interfaces (logical=physical port)
Clock: target tuni.fi:interface:clock:1.0
  clk=clk_in
IRQ: initiator tuni.fi:interface:IRQ:1.0
  irq=irq_1
APB: target tuni.fi:interface:APB:1.0
  PADDR=PADDR, PENABLE=PENABLE, PRDATA=PRDATA, PREADY=PREADY, PSEL=PSEL, PSLVERR=PSELERR, PWDATA=PWDATA, PWRITE=PWRITE
Reset: target tuni.fi:interface:reset:1.0
  reset=reset_int
ss_ctrl: target tuni.fi:interface:SS_Ctrl:1.0
  clk_ctrl=ss_ctrl_1, irq_en=irq_en_1
gpio: initiator tuni.fi:interface:GPIO:1.0
  gpo=gpo_o, gpi=gpi_i, gpio_oe=gpio_oe

## Ports
in clk_in
out irq_1
in PADDR[APB_AW-1:0]
in PENABLE
out PRDATA[APB_DW-1:0]
out PREADY
in PSEL
out PSELERR
in PWDATA[APB_DW-1:0]
in PWRITE
in reset_int
in ss_ctrl_1[7:0]
in irq_en_1
out gpo_o[1:0]
in gpi_i[1:0]
out gpio_oe[1:0]

## Address spaces and blocks
memoryMap.addressBlock: base 'h0, range 8, width 32

## Registers
Registers are 32-bit, read-write, no defined reset value unless marked. A register's access mark holds for its fields unless they carry their own. Offsets are from the block's base; lines under a group give offsets from that group; [hi:lo] are bit positions; {n}, {i} and the like mark numbered series; 'fields as' and 'values as' point back to an identical list; <NAME> marks a mode.

## memoryMap.addressBlock
Base 0x00000000
0x00 field0
  [31:0] field
0x04 field1 ro
  [31:0] field
