# apb_uart: IP-XACT component
VLNV tuni.fi:pulp.peripheral:apb_uart:1.0
Ipxact packaging for pulp platform uart module: https://github.com/pulp-platform/apb_uart

## Bus interfaces (logical=physical port)
Clock: target tuni.fi:interface:clock:1.0
  clk=CLK
Reset: target tuni.fi:interface:reset:1.0
  reset=RSTN
UART: initiator tuni.fi:interface:UART:1.0
  uart_rx=SIN, uart_tx=SOUT
APB: target tuni.fi:interface:APB:1.0, memory map apb_uart
  PADDR[4:2]=PADDR[2:0], PENABLE=PENABLE, PRDATA=PRDATA, PREADY=PREADY, PSEL=PSEL, PSLVERR=PSLVERR, PWDATA=PWDATA, PWRITE=PWRITE
IRQ: initiator tuni.fi:interface:IRQ:1.0
  irq=INT

## Ports
in CLK
in RSTN
in PSEL
in PENABLE
in PWRITE
in PADDR[2:0]
in PWDATA[31:0]
out PRDATA[31:0]
out PREADY
out PSLVERR
out INT — Interrupt
out OUT1N
out OUT2N
out RTSN
out DTRN
in CTSN
in DSRN
in DCDN
in RIN
in SIN — uart rx in
out SOUT — uart tx out

## Address spaces and blocks
apb_uart.registers: base 'h0, range 32, width 8

## Registers
Registers are 8-bit, access not given, no defined reset value unless marked. A register's access mark holds for its fields unless they carry their own. Offsets are from the block's base; lines under a group give offsets from that group; [hi:lo] are bit positions; {n}, {i} and the like mark numbered series; 'fields as' and 'values as' point back to an identical list; <NAME> marks a mode.

## apb_uart.registers
Base 0x00000000
0x00 RBR_THR_DLL — RBR_THR_DLL is a multi-purpose register address. you can access 3 different registers using the same address. IF LCR[7] is 0 RBR and THR are accessable. OW DLL is accessable. RBR read only. Reads from rx fifo THR write only. Writes into a tx fifo DLL writes/reads into/from the 8 LSBs in the divisor
0x04 IER_DLM — IER_DLM is a multi-purpose register address. you can access 2 different registers using the same address. IF LCR[7] is 0 IER is accessable. O.W DLM is accessable. IER writes/reads into/from position IER => IER[2:0]: The interrupt enable bits. => xx1: Interrupt is raised when Received data available or trigger level reached in FIFO mode if non of these it checks Character timeout indication. => x10: Interrupt is raised when Transmitter holding register empty. => 100: Interrupt is raised when Overrun error, parity error, framing error or break interrupt. => other bits aren't used
0x08 IIR_FCR — IIR_FCR is a multi-purpose register address. you can access 2 different registers using the same address. However LCR[7] isn't needed in this case because one of them is only written and the other is only read. FCR (fifo control register) write only => FCR[1]: clears the rx fifo if high => FCR[2]: clears the tx fifo if high => FCR[7:6]: sets the trigger level =>00: trigger level is high when there is 1 element in the fifo =>01: trigger level is high when there are 4 elements in the fifo =>10: trigger level is high when there are 8 elements in the fifo =>11: trigger level is high when there are 14 elements in the fifo => other bits aren't used IIR (Interrupt Identification Register) read only
0x0C LCR — LCR is a register configures the main operation of the uart. It configures the width of the received data, stop bit, parity, and DLAB bit. => LCR[1:0]: configuration bits =>00: data is configured to be 5 bits =>01: data is configured to be 6 bits =>10: data is configured to be 7 bits =>11: data is configured to be 8 bits => LCR[2]: stop bit configuration =>0: 1 stop bit =>1: 1.5 stop bits for 5 bits data word OR 2 stop bits 6, 7 or 8 bits data word => LCR[3]: parity enable bit => LCR[7]: divisor latch access bit (DLAB) =>0: RBR, THR and IER accessible =>1: DLL and DLM accessible => other bits aren't used
0x10 MCR — modem control
0x14 LSR — LSR is the line status register => LSR[0]: rx fifo data valid => LSR[2]: parity error from the rx fifo => LSR[5]: the tx fifo is empty => LSR[6]: shift register and tx fifo are empty => other bits aren't used
0x18 MSR — modem status
0x1C SCR — scratch
