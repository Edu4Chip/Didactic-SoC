# Student_area_0: IP-XACT component
VLNV tuni.fi:ip:Student_area_0:1.0
very basic example of logic for plausible student block.

## Bus interfaces (logical=physical port)
APB: target tuni.fi:interface:APB:1.0
  PADDR=PADDR, PENABLE=PENABLE, PRDATA[31:0]=PRDATA[31:0], PREADY[0:0]=PREADY[0:0], PSEL[0:0]=PSEL[0:0], PSLVERR[0:0]=PSELERR[0:0], PWDATA[31:0]=PWDATA[31:0], PWRITE=PWRITE
IRQ: initiator tuni.fi:interface:IRQ:1.0
  irq=irq
SS_Ctrl: target tuni.fi:interface:SS_Ctrl:1.0
  clk_ctrl=clk_ctrl, irq_en=irq_en
clk: target tuni.fi:interface:clock:1.0
  clk=clk_in
reset: target tuni.fi:interface:reset:1.0
  reset=rst

## Ports
in PADDR[31:0]
in PENABLE
out PRDATA[31:0]
out PREADY
in PSEL
out PSELERR
in PWDATA[31:0]
in PWRITE
out irq
in clk_ctrl[7:0]
in irq_en
in clk_in
in rst

## Address spaces and blocks
memoryMap.addressBlock: base 'h0, range 8, width 32

## Registers
Registers are 32-bit, read-write, no defined reset value unless marked. A register's access mark holds for its fields unless they carry their own. Offsets are from the block's base; lines under a group give offsets from that group; [hi:lo] are bit positions; {n}, {i} and the like mark numbered series; 'fields as' and 'values as' point back to an identical list; <NAME> marks a mode.

## memoryMap.addressBlock
Base 0x00000000
0x00 regfield0
  [31:0] field
